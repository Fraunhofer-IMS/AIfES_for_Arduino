/*
  AIfES MNIST FCNN Training (1 hidden layer with 10 neurons) - Arduino ESP32 Version

  Platform:
    ESP32 + Arduino Framework
*/

#include <Arduino.h>
#include <stdlib.h>
#include <stdint.h>
#include <string.h>

#include <aifes.h>

#define N_EPOCH 10

#define TRAIN_SAMPLES 10
#define BATCH_SIZE 5

#define IMG_SIZE (28 * 28)
#define NUM_CLASSES 10

// Increase stack size
SET_LOOP_TASK_STACK_SIZE(32 * 1024);

// ------------------------------------------------------------
// STATIC MNIST DATA
// ------------------------------------------------------------

/*
 * Put your full MNIST arrays here.
 * Truncated below for readability.
 */

static const uint8_t mnist_images[][IMG_SIZE] = {
  { 0, 0, 0, 0, 0, 0, 0, 0, 0, 0, 0, 0, 0,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 0, 0 },
  { 0, 0, 0, 0, 0, 0, 0, 0, 0, 0, 0, 0, 0,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 0, 0 },
  { 0, 0, 0, 0, 0, 0, 0, 0, 0, 0, 0, 0, 0,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 0, 0 },
  { 0, 0, 0, 0, 0, 0, 0, 0, 0, 0, 0, 0, 0,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 0, 0 },
  { 0, 0, 0, 0, 0, 0, 0, 0, 0, 0, 0, 0, 0,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 0, 0 },
  { 0, 0, 0, 0, 0, 0, 0, 0, 0, 0, 0, 0, 0,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 0, 0 },
  { 0, 0, 0, 0, 0, 0, 0, 0, 0, 0, 0, 0, 0,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 0, 0 },
  { 0, 0, 0, 0, 0, 0, 0, 0, 0, 0, 0, 0, 0,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 0, 0 },
  { 0, 0, 0, 0, 0, 0, 0, 0, 0, 0, 0, 0, 0,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 0, 0 },
  { 0, 0, 0, 0, 0, 0, 0, 0, 0, 0, 0, 0, 0,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 0, 0 },
};

static const uint8_t mnist_labels[] = {
  0, 1, 2, 3, 4, 5, 6, 7, 8, 9
};

// ------------------------------------------------------------
// ASCII VISUALIZATION
// ------------------------------------------------------------

static const char codeLib[] =
  "@B%8&WM#*oahkbdpqwmZO0QLCJUYXzcvunxrjft/\\|()1{}[]?-_+~<>i!lI;:,\"^`'.   ";

void mnist_print_img(const float *buf) {
  for (int y = 0; y < 28; y++) {
    for (int x = 0; x < 28; x++) {
      int index = 0;

      if (buf[y * 28 + x] > (75.0f / 255.0f)) {
        index = 69;
      }

      if (index < 0) {
        index = 0;
      }

      Serial.print(codeLib[index]);
      Serial.print(codeLib[index]);
    }

    Serial.println();
  }
}

// ------------------------------------------------------------
// GLOBAL DATA BUFFERS
// ------------------------------------------------------------

static float input_data[TRAIN_SAMPLES * IMG_SIZE];
static float target_data[TRAIN_SAMPLES * NUM_CLASSES];

// ------------------------------------------------------------
// GLOBAL AIfES OBJECTS
// ------------------------------------------------------------

static aimodel_t model;

static ailayer_input_f32_t input_layer;

static ailayer_dense_f32_t dense1;

static ailayer_flatten_t flatten;
static ailayer_dense_f32_t dense;
static ailayer_softmax_f32_t softmax;

static ailoss_crossentropy_f32_t loss_fn;

static aiopti_adam_f32_t adam;

// ------------------------------------------------------------
// GLOBAL MEMORY POINTERS
// ------------------------------------------------------------

static void *param_mem = NULL;
static void *train_mem = NULL;

// ------------------------------------------------------------
// SETUP
// ------------------------------------------------------------

void setup() {
  Serial.begin(115200);

  delay(2000);

  Serial.println();
  Serial.println("AIfES MNIST 2D-CNN Training");
  Serial.println();

  srand(1);

  // --------------------------------------------------------
  // INPUT DATA
  // --------------------------------------------------------

  for (size_t i = 0; i < TRAIN_SAMPLES; i++) {
    for (size_t j = 0; j < IMG_SIZE; j++) {
      input_data[i * IMG_SIZE + j] =
        (float)mnist_images[i][j] / 255.0f;
    }
  }

  // --------------------------------------------------------
  // TARGET DATA
  // --------------------------------------------------------

  memset(target_data, 0, sizeof(target_data));

  for (int i = 0; i < TRAIN_SAMPLES; i++) {
    target_data[i * NUM_CLASSES + mnist_labels[i]] = 1.0f;
  }

  // --------------------------------------------------------
  // PRINT DATASET
  // --------------------------------------------------------

  for (int i = 0; i < TRAIN_SAMPLES; i++) {
    Serial.println();
    Serial.print("--- Image ");
    Serial.print(i);
    Serial.println(" ---");

    mnist_print_img(
      &input_data[i * IMG_SIZE]);

    Serial.print("Label: ");
    Serial.println(mnist_labels[i]);
  }

}

void loop() {
 // --------------------------------------------------------
  // TENSORS
  // --------------------------------------------------------

  uint16_t input_shape[] = {
    TRAIN_SAMPLES,
    1,
    28,
    28
  };

  aitensor_t input_tensor =
    AITENSOR_4D_F32(
      input_shape,
      input_data);

  uint16_t target_shape[] = {
    TRAIN_SAMPLES,
    NUM_CLASSES
  };

  aitensor_t target_tensor =
    AITENSOR_2D_F32(
      target_shape,
      target_data);

  // --------------------------------------------------------
  // MODEL
  // --------------------------------------------------------

  uint16_t input_layer_shape[] = {
    1,
    1,
    28,
    28
  };

  input_layer =
    AILAYER_INPUT_F32_A(
      4,
      input_layer_shape);

  dense1 =
    AILAYER_DENSE_F32_A(
      10);

  flatten =
    AILAYER_FLATTEN_F32_A();

  dense =
    AILAYER_DENSE_F32_A(
      NUM_CLASSES);

  softmax =
    AILAYER_SOFTMAX_F32_A();

  // --------------------------------------------------------
  // COMPILE MODEL
  // --------------------------------------------------------

  ailayer_t *x;

  model.input_layer =
    ailayer_input_f32_default(
      &input_layer);

  x = ailayer_flatten_f32_default(
    &flatten,
    model.input_layer);

  x = ailayer_dense_f32_default(
    &dense1,
    x);

  x = ailayer_dense_f32_default(
    &dense,
    x);

  x = ailayer_softmax_f32_default(
    &softmax,
    x);

  model.output_layer = x;

  model.loss =
    ailoss_crossentropy_f32_default(
      &loss_fn,
      model.output_layer);

  aialgo_compile_model(&model);

  Serial.println();
  Serial.println("--- Model Compiled ---");


  // ------------------------------------- Print the model structure ------------------------------------

  Serial.print("-------------- Model structure ---------------\n");
  aialgo_print_model_structure(&model);
  Serial.print("----------------------------------------------\n\n");

  // --------------------------------------------------------
  // PARAMETER MEMORY
  // --------------------------------------------------------

  uint32_t param_size =
    aialgo_sizeof_parameter_memory(
      &model);

  Serial.print("Parameter memory: ");
  Serial.print(param_size);
  Serial.println(" bytes");

  param_mem =
    malloc(param_size);

  if (param_mem == NULL) {
    Serial.println("Failed to allocate parameter memory");
    return;
  }

  aialgo_distribute_parameter_memory(
    &model,
    param_mem,
    param_size);

  aialgo_initialize_parameters_model(
    &model);

  // --------------------------------------------------------
  // OPTIMIZER
  // --------------------------------------------------------

  aiopti_adam_f32_t adam =
    AIOPTI_ADAM_F32(
      0.01f,
      0.9f,
      0.999f,
      1e-5f);

  aiopti_t *opt =
    aiopti_adam_f32_default(
      &adam);

  // --------------------------------------------------------
  // TRAIN MEMORY
  // --------------------------------------------------------

  uint32_t mem_size =
    aialgo_sizeof_training_memory(
      &model,
      opt);

  Serial.print("Training memory size = ");
  Serial.print(mem_size);
  Serial.println(" bytes");

  void *mem =
    malloc(mem_size);

  if (mem == NULL) {
    Serial.println("Failed to allocate training memory");
    return;
  }

  aialgo_schedule_training_memory(
    &model,
    opt,
    mem,
    mem_size);

  aialgo_init_model_for_training(
    &model,
    opt);

  // --------------------------------------------------------
  // TRAINING
  // --------------------------------------------------------

  Serial.println();
  Serial.println("Start training...");

  float loss;

  unsigned long total_time = 0;
  for (int e = 0; e < N_EPOCH; e++) {

    unsigned long start_time = millis();

    aialgo_train_model(
      &model,
      &input_tensor,
      &target_tensor,
      opt,
      BATCH_SIZE);

    aialgo_calc_loss_model_f32(
      &model,
      &input_tensor,
      &target_tensor,
      &loss);

    unsigned long epoch_time = millis() - start_time;
    total_time += epoch_time;

    Serial.print("Epoch ");
    Serial.print(e);
    Serial.print(" loss = ");
    Serial.print(loss, 6);

    Serial.print(" | time = ");
    Serial.print(epoch_time);
    Serial.println(" ms");
  }

  Serial.print("Average epoch time = ");
  Serial.print(total_time / 10.0);
  Serial.println(" ms");

  // --------------------------------------------------------
  // INFERENCE
  // --------------------------------------------------------

  float output_data[NUM_CLASSES];

  uint16_t test_shape[] = {
    1,
    1,
    28,
    28
  };

  aitensor_t test_tensor =
    AITENSOR_4D_F32(
      test_shape,
      &input_data[0]);

  uint16_t output_shape[] = {
    1,
    NUM_CLASSES
  };

  aitensor_t output_tensor =
    AITENSOR_2D_F32(
      output_shape,
      output_data);

  Serial.println();
  Serial.println("--- Inference Test ---");

  mnist_print_img(&input_data[0]);

  unsigned long start_time = micros();

  aialgo_inference_model(
    &model,
    &test_tensor,
    &output_tensor);

  unsigned long inference_time = micros() - start_time;

  Serial.print("Inference time: ");
  Serial.print(inference_time);
  Serial.println(" us");

  Serial.println();
  Serial.println("Output probabilities:");

  for (int i = 0; i < NUM_CLASSES; i++) {
    Serial.print(i);
    Serial.print(": ");
    Serial.println(output_data[i], 6);
  }

  // --------------------------------------------------------
  // ARGMAX
  // --------------------------------------------------------

  int predicted_class = 0;
  float max_prob = output_data[0];

  for (int j = 1; j < NUM_CLASSES; j++) {
    if (output_data[j] > max_prob) {
      max_prob = output_data[j];
      predicted_class = j;
    }
  }

  Serial.println();

  Serial.print("Predicted = ");
  Serial.println(predicted_class);

  Serial.print("True      = ");
  Serial.println(mnist_labels[0]);

  // --------------------------------------------------------
  // CLEANUP
  // --------------------------------------------------------

  free(mem);
  free(param_mem);

  Serial.println();
  Serial.println("Done.");
  while(1);
}
